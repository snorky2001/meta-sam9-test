## conf/layer.conf
```bitbake
# We have a conf and classes directory, add to BBPATH
BBPATH .= ":${LAYERDIR}"

# We have recipes-* directories, add to BBFILES
BBFILES += "${LAYERDIR}/recipes-*/*/*.bb \
            ${LAYERDIR}/recipes-*/*/*.bbappend"

BBFILE_COLLECTIONS += "meta-sam9-test"
BBFILE_PATTERN_meta-sam9-test = "^${LAYERDIR}/"
BBFILE_PRIORITY_meta-sam9-test = "6"

LAYERDEPENDS_meta-sam9-test = "core"
LAYERSERIES_COMPAT_meta-sam9-test = "dunfell"
```
